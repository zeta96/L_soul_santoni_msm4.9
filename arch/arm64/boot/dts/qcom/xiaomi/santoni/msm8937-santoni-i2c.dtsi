&i2c_2  {
	aw87319@58{ /*AW87319 PA*/
		compatible = "awinic,aw87319_pa";
		reg = <0x58>;
		qcom,ext_pa_spk_aw87319_rst = <&tlmm 124 0>;
	};
};

&i2c_3 {
	focaltech@38{
		compatible = "focaltech,fts_ts";
		reg = <0x38>;
		interrupt-parent = <&tlmm>;
		interrupts = <65 0x2008>;
		vdd-supply = <&pm8937_l10>;
		vcc_i2c-supply = <&pm8937_l5>;
		pinctrl-names = "pmx_ts_active","pmx_ts_suspend",
		"pmx_ts_release";
		pinctrl-0 = <&ts_int_active &ts_reset_active>;
		pinctrl-1 = <&ts_int_suspend &ts_reset_suspend>;
		pinctrl-2 = <&ts_release>;
		focaltech,reset-gpio = <&tlmm 64 0x00>;
		focaltech,irq-gpio = <&tlmm 65 0x2008>;
		focaltech,display-coords = <0 0 720 1280>;
		focaltech,max-touch-number = <10>;
		focaltech,have-key;
		focaltech,key-number = <3>;
		focaltech,keys = <139 172 158>;
		focaltech,key-y-coords = <2000 2000 2000>;
		focaltech,key-x-coords = <140 360 580>;
	};
};
